#include <dt-bindings/zmk/matrix_transform.h>
#include "lio46.dtsi"




&kscan0 {
    col-gpios
        = <&pro_micro 21 GPIO_ACTIVE_HIGH> // 031
        , <&pro_micro 20 GPIO_ACTIVE_HIGH> // 029
        , <&pro_micro 19 GPIO_ACTIVE_HIGH> // 002
        , <&pro_micro 18 GPIO_ACTIVE_HIGH> // 115
        , <&pro_micro 15 GPIO_ACTIVE_HIGH> // 113
        , <&pro_micro 14 GPIO_ACTIVE_HIGH> // 111
        , <&pro_micro 16 GPIO_ACTIVE_HIGH> // 010
        ;
};
