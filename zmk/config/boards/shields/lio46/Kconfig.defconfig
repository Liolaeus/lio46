## zmk/config/boards/shields/lio46/Kconfig.defconfig
```kconfig
if SHIELD_LIO46_LEFT

# Name must be less than 16 characters long!
config ZMK_KEYBOARD_NAME
    default "Lio 46"

config ZMK_SPLIT_ROLE_CENTRAL
    default y

endif

if SHIELD_LIO46_LEFT || SHIELD_LIO46_RIGHT

config ZMK_SPLIT
    default y

endif
```

## zmk/config/boards/shields/lio46/Kconfig.shield
```kconfig
config SHIELD_LIO46_LEFT
    def_bool $(shields_list_contains,lio46_left)

config SHIELD_LIO46_RIGHT
    def_bool $(shields_list_contains,lio46_right)
```
